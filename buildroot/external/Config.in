## buildroot/external/Config.in
```kconfig
source "$BR2_EXTERNAL_SATIP_PATH/package/satip-app/Config.in"
source "$BR2_EXTERNAL_SATIP_PATH/package/python-satip-yt-dlp/Config.in"
source "$BR2_EXTERNAL_SATIP_PATH/package/satip-splash/Config.in"
```

## buildroot/external/configs/satip_rpi4_64_defconfig
```kconfig
# Development foundation/media qualification, derived from raspberrypi4_64_defconfig.
BR2_aarch64=y
BR2_cortex_a72=y
BR2_ARM_FPU_VFPV4=y
BR2_TOOLCHAIN_EXTERNAL=y
BR2_TOOLCHAIN_EXTERNAL_BOOTLIN=y
BR2_TOOLCHAIN_EXTERNAL_BOOTLIN_AARCH64_GLIBC_STABLE=y
BR2_GLOBAL_PATCH_DIR="board/raspberrypi/patches $(BR2_EXTERNAL_SATIP_PATH)/patches"
BR2_DOWNLOAD_FORCE_CHECK_HASHES=y
BR2_INIT_BUSYBOX=y
BR2_ROOTFS_DEVICE_CREATION_DYNAMIC_EUDEV=y
BR2_PACKAGE_EUDEV_MODULE_LOADING=y
BR2_TARGET_GENERIC_HOSTNAME="satip-dev"
BR2_TARGET_GENERIC_ISSUE="SAT-IP development foundation (not a production appliance)"
# BR2_TARGET_ENABLE_ROOT_LOGIN is not set
BR2_TARGET_GENERIC_GETTY_PORT="ttyAMA0"
BR2_TARGET_GENERIC_GETTY_BAUDRATE_115200=y
BR2_SYSTEM_DHCP=""
BR2_TARGET_TZ_INFO=y
BR2_TARGET_LOCALTIME="Etc/UTC"
BR2_ROOTFS_OVERLAY="$(BR2_EXTERNAL_SATIP_PATH)/board/satip/rootfs-overlay"
BR2_ROOTFS_USERS_TABLES="$(BR2_EXTERNAL_SATIP_PATH)/board/satip/users.txt"
BR2_ROOTFS_POST_BUILD_SCRIPT="$(BR2_EXTERNAL_SATIP_PATH)/board/satip/post-build.sh"
BR2_ROOTFS_POST_IMAGE_SCRIPT="$(BR2_EXTERNAL_SATIP_PATH)/board/satip/post-image.sh"
BR2_LINUX_KERNEL=y
BR2_LINUX_KERNEL_CUSTOM_TARBALL=y
BR2_LINUX_KERNEL_CUSTOM_TARBALL_LOCATION="$(call github,raspberrypi,linux,21b410140c47ffab5668399f6f143c7d7b935c8b)/linux-21b410140c47ffab5668399f6f143c7d7b935c8b.tar.gz"
BR2_LINUX_KERNEL_DEFCONFIG="bcm2711"
BR2_LINUX_KERNEL_CONFIG_FRAGMENT_FILES="$(BR2_EXTERNAL_SATIP_PATH)/board/satip/linux-devices.fragment"
BR2_LINUX_KERNEL_DTS_SUPPORT=y
BR2_LINUX_KERNEL_INTREE_DTS_NAME="broadcom/bcm2711-rpi-4-b broadcom/bcm2711-rpi-400 broadcom/bcm2711-rpi-cm4 broadcom/bcm2711-rpi-cm4s"
BR2_LINUX_KERNEL_NEEDS_HOST_OPENSSL=y
BR2_PACKAGE_BUSYBOX_SHOW_OTHERS=y
BR2_PACKAGE_BUSYBOX_CONFIG_FRAGMENT_FILES="$(BR2_EXTERNAL_SATIP_PATH)/board/satip/busybox.fragment"
BR2_PACKAGE_XZ=y
BR2_PACKAGE_KMOD=y
BR2_PACKAGE_KMOD_TOOLS=y
BR2_PACKAGE_RPI_FIRMWARE=y
BR2_PACKAGE_RPI_FIRMWARE_VARIANT_PI4=y
BR2_PACKAGE_RPI_FIRMWARE_INSTALL_DTB_OVERLAYS=y
BR2_PACKAGE_RPI_FIRMWARE_CONFIG_FILE="$(BR2_EXTERNAL_SATIP_PATH)/board/satip/config.txt"
BR2_PACKAGE_RPI_FIRMWARE_CMDLINE_FILE="$(BR2_EXTERNAL_SATIP_PATH)/board/satip/cmdline.txt"
BR2_PACKAGE_BRCMFMAC_SDIO_FIRMWARE_RPI=y
BR2_PACKAGE_BRCMFMAC_SDIO_FIRMWARE_RPI_WIFI=y
BR2_PACKAGE_WIRELESS_REGDB=y
BR2_PACKAGE_IW=y
BR2_PACKAGE_WPA_SUPPLICANT=y
BR2_PACKAGE_WPA_SUPPLICANT_NL80211=y
BR2_PACKAGE_WPA_SUPPLICANT_CTRL_IFACE=y
BR2_PACKAGE_CA_CERTIFICATES=y
BR2_PACKAGE_CHRONY=y
BR2_PACKAGE_DROPBEAR=y
BR2_PACKAGE_PYTHON3=y
BR2_PACKAGE_PYTHON3_PYEXPAT=y
BR2_PACKAGE_PYTHON3_ZLIB=y
BR2_PACKAGE_SATIP_APP=y
BR2_PACKAGE_SATIP_SPLASH=y
BR2_PACKAGE_TVHEADEND_SATIP=y
# BR2_PACKAGE_TVHEADEND_DESCRAMBLER is not set
BR2_PACKAGE_TVHEADEND_IPTV=y
# BR2_PACKAGE_TVHEADEND_TIMESHIFT is not set
# BR2_PACKAGE_TVHEADEND_TRANSCODING is not set
BR2_PACKAGE_UTIL_LINUX=y
BR2_PACKAGE_UTIL_LINUX_BINARIES=y
BR2_PACKAGE_UTIL_LINUX_LIBBLKID=y
BR2_PACKAGE_E2FSPROGS=y
BR2_PACKAGE_KBD=y
BR2_PACKAGE_ALSA_LIB=y
BR2_PACKAGE_ALSA_UTILS=y
BR2_PACKAGE_ALSA_UTILS_APLAY=y
BR2_PACKAGE_ALSA_UTILS_AMIXER=y
BR2_PACKAGE_LIBDRM=y
BR2_PACKAGE_LIBDRM_VC4=y
BR2_PACKAGE_LIBDRM_INSTALL_TESTS=y
BR2_PACKAGE_LIBV4L=y
BR2_PACKAGE_LIBV4L_UTILS=y
# Phase 2: retain broad codec/filter defaults until target parity is qualified.
BR2_PACKAGE_MESA3D=y
BR2_PACKAGE_MESA3D_GALLIUM_DRIVER_V3D=y
BR2_PACKAGE_MESA3D_GALLIUM_DRIVER_VC4=y
BR2_PACKAGE_MESA3D_GBM=y
BR2_PACKAGE_MESA3D_OPENGL_EGL=y
BR2_PACKAGE_MESA3D_OPENGL_ES=y
BR2_PACKAGE_MPV=y
BR2_PACKAGE_LIBASS=y
BR2_PACKAGE_FONTCONFIG=y
BR2_PACKAGE_DEJAVU=y
BR2_PACKAGE_DEJAVU_SANS=y
# BR2_PACKAGE_DEJAVU_MONO is not set
# BR2_PACKAGE_DEJAVU_SERIF is not set
# BR2_PACKAGE_DEJAVU_SANS_CONDENSED is not set
# BR2_PACKAGE_DEJAVU_SERIF_CONDENSED is not set
BR2_PACKAGE_FFMPEG=y
BR2_PACKAGE_FFMPEG_GPL=y
# BR2_PACKAGE_FFMPEG_NONFREE is not set
BR2_PACKAGE_FFMPEG_FFMPEG=y
BR2_PACKAGE_FFMPEG_FFPROBE=y
BR2_PACKAGE_FFMPEG_SWSCALE=y
BR2_PACKAGE_FFMPEG_ENCODERS="all"
BR2_PACKAGE_FFMPEG_DECODERS="all"
BR2_PACKAGE_FFMPEG_MUXERS="all"
BR2_PACKAGE_FFMPEG_DEMUXERS="all"
BR2_PACKAGE_FFMPEG_PARSERS="all"
BR2_PACKAGE_FFMPEG_BSFS="all"
BR2_PACKAGE_FFMPEG_PROTOCOLS="all"
BR2_PACKAGE_FFMPEG_FILTERS="all"
BR2_PACKAGE_X264=y
BR2_PACKAGE_ETHTOOL=y
BR2_PACKAGE_HTOP=y
BR2_TARGET_ROOTFS_EXT2=y
BR2_TARGET_ROOTFS_EXT2_4=y
BR2_TARGET_ROOTFS_EXT2_SIZE="768M"
BR2_TARGET_ROOTFS_EXT2_LABEL="satip-dev-root"
# BR2_TARGET_ROOTFS_TAR is not set
BR2_PACKAGE_HOST_DOSFSTOOLS=y
BR2_PACKAGE_HOST_GENIMAGE=y
BR2_PACKAGE_HOST_KMOD_XZ=y
BR2_PACKAGE_HOST_MTOOLS=y
```

## buildroot/external/package/python-satip-yt-dlp/Config.in
```kconfig
config BR2_PACKAGE_PYTHON_SATIP_YT_DLP
	bool "SAT-IP YouTube resolver"
	depends on BR2_PACKAGE_PYTHON3
	select BR2_PACKAGE_PYTHON3_ZLIB
	select BR2_PACKAGE_PYTHON3_PYEXPAT
	help
	  Pinned yt-dlp for the opt-in TV-code receiver. Public H.264/AAC
	  streams only; JavaScript runtime-dependent videos are not qualified.
```

## buildroot/external/package/satip-app/Config.in
```kconfig
config BR2_PACKAGE_SATIP_APP
	bool "SAT-IP application and appliance services"
	depends on BR2_PACKAGE_PYTHON3
	depends on BR2_PACKAGE_HOST_RUSTC_TARGET_ARCH_SUPPORTS
	select BR2_PACKAGE_PYTHON_EVDEV
	select BR2_PACKAGE_PYTHON_ZEROCONF
	select BR2_PACKAGE_PYTHON_FASTAPI
	select BR2_PACKAGE_PYTHON_UVICORN
	select BR2_PACKAGE_PYTHON_HTTPX
	select BR2_PACKAGE_PYTHON_SATIP_YT_DLP
	select BR2_PACKAGE_PYTHON3_PYEXPAT
	select BR2_PACKAGE_PYTHON3_ZLIB
	select BR2_PACKAGE_TVHEADEND
	help
	  Root-owned application, static assets and fail-closed BusyBox services.
	  No target pip or production configuration is included.
```

## buildroot/external/package/satip-splash/Config.in
```kconfig
config BR2_PACKAGE_SATIP_SPLASH
	bool "SAT-IP HDMI-Startbildschirm"
	depends on BR2_PACKAGE_SATIP_APP
	select BR2_PACKAGE_LIBDRM
	select BR2_PACKAGE_FREETYPE
	select BR2_PACKAGE_DEJAVU
	select BR2_PACKAGE_DEJAVU_SANS
	help
	  Früher DRM/KMS-Startbildschirm mit englischer/deutscher Fortschrittsanzeige (Standard: Englisch).
```
